## boot/tf-m/Config.in
```kconfig
config BR2_TARGET_TF_M
	bool "TrustedFirmware-M (TF-M)"
	select BR2_HOST_CMAKE_AT_LEAST_3_21
	select BR2_TARGET_TFM_CMSIS
	select BR2_TARGET_TFM_MBEDTLS
	select BR2_TARGET_TFM_MCUBOOT
	select BR2_TARGET_TFM_QCBOR
	help
	  Enable this option if you want to build the TF-M for your
	  ARMv8-M microcontroller.

	  https://trustedfirmware-m.readthedocs.io

if BR2_TARGET_TF_M
choice
	prompt "TF-M Version"
	help
	  Select the specific TF-M version you want to use

config BR2_TARGET_TF_M_LATEST_VERSION
	bool "v2.1.0"

config BR2_TARGET_TF_M_CUSTOM_VERSION
	bool "Custom version"
	help
	  This option allows to use a specific official version

config BR2_TARGET_TF_M_CUSTOM_TARBALL
	bool "Custom tarball"

config BR2_TARGET_TF_M_CUSTOM_GIT
	bool "Custom Git repository"

endchoice

config BR2_TARGET_TF_M_CUSTOM_TARBALL_LOCATION
	string "URL of custom TF-M tarball"
	depends on BR2_TARGET_TF_M_CUSTOM_TARBALL

config BR2_TARGET_TF_M_CUSTOM_VERSION_VALUE
	string "TF-M version"
	depends on BR2_TARGET_TF_M_CUSTOM_VERSION

if BR2_TARGET_TF_M_CUSTOM_GIT

config BR2_TARGET_TF_M_CUSTOM_REPO_URL
	string "URL of custom repository"

config BR2_TARGET_TF_M_CUSTOM_REPO_VERSION
	string "Custom repository version"
	help
	  Revision to use in the typical format used by Git
	  E.G. a sha id, a tag, ..

endif

config BR2_TARGET_TF_M_VERSION
	string
	default "0c4c99ba33b3e66deea070e149279278dc7647f4" \
				if BR2_TARGET_TF_M_LATEST_VERSION
	default "custom"	if BR2_TARGET_TF_M_CUSTOM_TARBALL
	default BR2_TARGET_TF_M_CUSTOM_REPO_VERSION \
				if BR2_TARGET_TF_M_CUSTOM_GIT
	default BR2_TARGET_TF_M_CUSTOM_VERSION_VALUE \
				if BR2_TARGET_TF_M_CUSTOM_VERSION

source "boot/tf-m/tfm-cmsis/Config.in"
source "boot/tf-m/tfm-mbedtls/Config.in"
source "boot/tf-m/tfm-mcuboot/Config.in"
source "boot/tf-m/tfm-qcbor/Config.in"

config BR2_TARGET_TF_M_PLATFORM
	string "TF-M platform path"
	help
	  Target plaform path to build for.
	  E.G. 'arm/mps2/an521'

config BR2_TARGET_TF_M_ADDITIONAL_VARIABLES
	string "Additional TF-M build variables"
	help
	  Additional parameters for the TF-M build
	  E.G. '-DTFM_ISOLATION_LEVEL=2 -DCMAKE_BUILD_TYPE=Debug'

endif
```

## boot/tf-m/tfm-cmsis/Config.in
```kconfig
config BR2_TARGET_TFM_CMSIS
	bool

config BR2_TARGET_TFM_CMSIS_GIT_REPO_URL
	string "URL of cmsis git repository" \
		if !BR2_TARGET_TF_M_LATEST_VERSION
	default "https://github.com/ARM-software/CMSIS_6.git"

config BR2_TARGET_TFM_CMSIS_GIT_REPO_VERSION
	string "cmsis repository version" \
		if !BR2_TARGET_TF_M_LATEST_VERSION
	default "d0c460c1697d210b49a4b90998195831c0cd325c"
```

## boot/tf-m/tfm-mbedtls/Config.in
```kconfig
config BR2_TARGET_TFM_MBEDTLS
	bool

config BR2_TARGET_TFM_MBEDTLS_GIT_REPO_URL
	string "URL of mbedtls git repository" \
		if !BR2_TARGET_TF_M_LATEST_VERSION
	default "https://github.com/Mbed-TLS/mbedtls.git"

config BR2_TARGET_TFM_MBEDTLS_GIT_REPO_VERSION
	string "mbedtls repository version" \
		if !BR2_TARGET_TF_M_LATEST_VERSION
	default "2ca6c285a0dd3f33982dd57299012dacab1ff206"
```

## boot/tf-m/tfm-mcuboot/Config.in
```kconfig
config BR2_TARGET_TFM_MCUBOOT
	bool

config BR2_TARGET_TFM_MCUBOOT_GIT_REPO_URL
	string "URL of mcuboot git repository" \
		if !BR2_TARGET_TF_M_LATEST_VERSION
	default "https://github.com/mcu-tools/mcuboot.git"

config BR2_TARGET_TFM_MCUBOOT_GIT_REPO_VERSION
	string "mcuboot repository version" \
		if !BR2_TARGET_TF_M_LATEST_VERSION
	default "9c99326b9756dbcc35b524636d99ed5f3e6cb29b"
```

## boot/tf-m/tfm-qcbor/Config.in
```kconfig
config BR2_TARGET_TFM_QCBOR
	bool

config BR2_TARGET_TFM_QCBOR_GIT_REPO_URL
	string "URL of qcbor git repository" \
		if !BR2_TARGET_TF_M_LATEST_VERSION
	default "https://github.com/laurencelundblade/qcbor.git"

config BR2_TARGET_TFM_QCBOR_GIT_REPO_VERSION
	string "qcbor repository version" \
		if !BR2_TARGET_TF_M_LATEST_VERSION
	default "92d3f89030baff4af7be8396c563e6c8ef263622"
```
